#include <hal/screen.hpp>

#include <Arduino.h>
#include <SPI.h>

namespace hal {

    static std::uint8_t s_enablePin;
    static std::uint8_t s_chipSelectPin;
    static std::array<std::uint8_t, Screen::Width * Screen::Height> s_frameBuffer = {};
    static bool s_turnedOn = true;

    void Screen::init(std::uint8_t sck, std::uint8_t miso, std::uint8_t mosi, std::uint8_t cs, std::uint8_t en) {
        ::pinMode(sck,  OUTPUT);
        ::pinMode(miso, INPUT);
        ::pinMode(mosi, OUTPUT);
        ::pinMode(cs,   OUTPUT);
        ::pinMode(en,   OUTPUT);

        SPI.pins(sck, miso, mosi, cs);
        SPI.begin();
        SPI.beginTransaction(SPISettings(10000000, MSBFIRST, SPI_MODE0));
        s_enablePin = en;
        s_chipSelectPin = cs;
        s_turnedOn = true;

        clear();
    }

    constexpr static std::array LedPositions = {
        0x0F, 0x0E, 0x0D, 0x0C, 0x0B, 0x0A, 0x09, 0x08, 0x18, 0x19, 0x1A, 0x1B, 0x1C, 0x1D, 0x1E, 0x1F,
        0x07, 0x06, 0x05, 0x04, 0x03, 0x02, 0x01, 0x00, 0x10, 0x11, 0x12, 0x13, 0x14, 0x15, 0x16, 0x17,
        0x27, 0x26, 0x25, 0x24, 0x23, 0x22, 0x21, 0x20, 0x30, 0x31, 0x32, 0x33, 0x34, 0x35, 0x36, 0x37,
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        0xEF, 0xEE, 0xED, 0xEC, 0xEB, 0xEA, 0xE9, 0xE8, 0xF8, 0xF9, 0xFA, 0xFB, 0xFC, 0xFD, 0xFE, 0xFF
    };

    void Screen::update() {
        if (!s_turnedOn) {
            return;
        }

        static std::uint32_t sendBuffer[(Width * Height + 8 * sizeof(std::uint32_t) - 1) / 8 / sizeof(std::uint32_t)] = { };
        auto *bits = reinterpret_cast<std::uint8_t*>(sendBuffer);

        std::memset(bits, 0x00, Width * Height / 8);

        static std::uint32_t counter = 0;
        for (std::uint32_t led = 0; led < Width * Height; led += 1) {
            std::uint8_t threshold = counter & 0xFF;
            bits[led >> 3] |= (s_frameBuffer[LedPositions[led]] > threshold ? 0x80 : 0x00) >> (led & 7);
        }
        counter += (256 / BrightnessLevels);

        ::digitalWrite(s_chipSelectPin, LOW);
        SPI.writeBytes(bits, sizeof(sendBuffer));
        ::digitalWrite(s_chipSelectPin, HIGH);
    }

    void Screen::setPixel(std::int8_t x, std::int8_t y, std::uint8_t brightness) {
        if (!s_turnedOn) brightness = 0x00;
        if (x < 0 || x >= Height || y < 0 || y >= Width) {
            return; // Out of bounds
        }

        s_frameBuffer[x + y * Height] = brightness;
    }

    void Screen::setPixelNoOverwrite(std::int8_t x, std::int8_t y, std::uint8_t brightness) {
        if (!s_turnedOn) brightness = 0x00;
        if (x < 0 || x >= Height || y < 0 || y >= Width) {
            return; // Out of bounds
        }

        auto &currentBrightness = s_frameBuffer[x + y * Height];
        if (currentBrightness == 0x00)
            currentBrightness = brightness;
    }

    std::uint8_t Screen::getPixel(std::int8_t x, std::int8_t y) {
        return (x < 0 || x >= Height || y < 0 || y >= Width) ? 0x00 : s_frameBuffer[x + y * Height];
    }


    void Screen::setAllPixels(const std::array<std::uint8_t, Width * Height> &pixels) {
        for (std::size_t i = 0; i < pixels.size(); ++i) {
            s_frameBuffer[i] = pixels[i];
        }
    }


    void Screen::clear(std::uint8_t brightness) {
        std::fill(s_frameBuffer.begin(), s_frameBuffer.end(), brightness);
    }

    bool Screen::isTurnedOn() {
        return s_turnedOn;
    }

    void Screen::turnOff() {
        s_turnedOn = false;
    }

    void Screen::turnOn() {
        s_turnedOn = true;
    }

}